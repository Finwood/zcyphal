## Kconfig
```kconfig
menuconfig ZCYPHAL
	bool "Cyphal v1.1 over CAN (zcyphal)"
	select CAN
	select HWINFO
	select LOG
	help
	  Enable the zcyphal module integrating Cyphal v1.1 with Zephyr CAN.

if ZCYPHAL

module = ZCYPHAL
module-str = zcyphal
source "${ZEPHYR_BASE}/subsys/logging/Kconfig.template.log_config"

config ZCYPHAL_HEAP_SIZE
	int "Cy heap size (bytes)"
	default 32768

config ZCYPHAL_NODE_HOME
	string "Default node home name"
	default "zcyphal"

config ZCYPHAL_CAN_FD
	bool "Enable CAN FD support"
	default n

config ZCYPHAL_CAN_LOOPBACK
	bool "Enable CAN controller loopback mode"
	default n
	help
	  Set CAN_MODE_LOOPBACK on the bound controller. Use with Zephyr
	  loopback CAN drivers (e.g. native_sim) for local TX/RX testing.

config ZCYPHAL_AUTO_INIT
	bool "Initialize zcyphal automatically at boot"
	default n

config ZCYPHAL_TX_QUEUE_SIZE
	int "Cyphal TX queue capacity"
	default 128

config ZCYPHAL_RX_QUEUE_SIZE
	int "Zephyr CAN RX queue depth"
	default 32

config ZCYPHAL_FILTER_COUNT
	int "Maximum concurrent CAN RX filters"
	default 8

config ZCYPHAL_THREAD_STACK_SIZE
	int "Spin thread stack size (bytes)"
	default 4096

config ZCYPHAL_THREAD_PRIORITY
	int "Spin thread priority"
	default 5

config ZCYPHAL_SPIN_SLICE_US
	int "Spin slice duration (microseconds)"
	default 10000

config ZCYPHAL_NAMESPACE
	string "Default Cyphal namespace"
	default ""

config ZCYPHAL_REMAP
	string "Default Cyphal name remap rules"
	default ""

config ZCYPHAL_PRNG_SEED
	hex "Fallback PRNG seed when hwinfo is unavailable"
	default 0x5a63797068616c00

config ZCYPHAL_TRACE
	bool "Enable cy internal trace logging"
	default n

endif
```

## tests/integration/test_zcyphal/testcase.yaml
```yaml
tests:
  zcyphal.integration:
    platform_allow: native_sim
    tags: zcyphal
  zcyphal.integration.canfd:
    platform_allow: native_sim
    extra_configs:
      - CONFIG_ZCYPHAL_CAN_FD=y
      - CONFIG_ZCYPHAL_CAN_LOOPBACK=y
    tags: zcyphal
```

## west.yml
```yaml
manifest:
  self:
    path: .

  remotes:
    - name: zephyrproject-rtos
      url-base: https://github.com/zephyrproject-rtos
    - name: opencyphal-garage
      url-base: https://github.com/OpenCyphal-Garage
    - name: opencyphal
      url-base: https://github.com/OpenCyphal

  projects:
    - name: zephyr
      remote: zephyrproject-rtos
      revision: v4.4.0
      clone-depth: 1
      west-commands: scripts/west-commands.yml
      import:
        path-prefix: deps
        name-allowlist:
          - cmsis_6

    - name: cy
      remote: opencyphal-garage
      repo-path: cy
      path: deps/cy
      revision: 0a3ab4d22f9f7109cd3e709306625d8d435700db
      submodules: true

    - name: libcanard
      remote: opencyphal
      path: deps/libcanard
      revision: 254b71601b2d9addf17db0284f4f04a929ff4902
```
